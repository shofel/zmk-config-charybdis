## dts/bindings/behaviors/zmk,behavior-rgb-local.yaml
```yaml
description: RGB underglow behavior that executes on the key event source side
compatible: "zmk,behavior-rgb-local"
include: one_param.yaml
```
